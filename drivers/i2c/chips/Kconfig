## drivers/i2c/chips/Kconfig
```kconfig
#
# Miscellaneous I2C chip drivers configuration
#
# *** DEPRECATED! Do not add new entries! See Makefile ***
#

menu "Miscellaneous I2C Chip support"

config DS1682
	tristate "Dallas DS1682 Total Elapsed Time Recorder with Alarm"
	depends on EXPERIMENTAL
	help
	  If you say yes here you get support for Dallas Semiconductor
	  DS1682 Total Elapsed Time Recorder.

	  This driver can also be built as a module.  If so, the module
	  will be called ds1682.

config TWL4030_POWEROFF
        bool "TWL4030 device poweroff"
        depends on TWL4030_CORE

config TWL4030_POWEROFF_VIATELECOM
	tristate "Power off and restart by TWL4030 Watchdog"
	depends on TWL4030_POWEROFF

config SENSORS_TSL2550
	tristate "Taos TSL2550 ambient light sensor"
	depends on EXPERIMENTAL
	help
	  If you say yes here you get support for the Taos TSL2550
	  ambient light sensor.

	  This driver can also be built as a module.  If so, the module
	  will be called tsl2550.

config SENSORS_PCA963X
	tristate "Philips PCA963X 4-bit I2C-bus LED"
	depends on I2C && EXPERIMENTAL
	help
	 If you say yes here you get support for the Philips PCA963X
	 4-bit I2C-bus LED.

	 This driver can also be built as a module.  If so, the module
	 will be called pca963X.

config TWL4030_MADC
	tristate "TWL4030 MADC Driver"
	depends on TWL4030_CORE
	help
	The TWL4030 Monitoring ADC driver enables the host
	processor to monitor analog signals using analog-to-digital
	conversions on the input source. TWL4030 MADC provides the
	following features:
	 - Single 10-bit ADC with successive approximation register (SAR) conversion;
	 - Analog multiplexer for 16 inputs;
	 - Seven (of the 16) inputs are freely available;
	 - Battery voltage monitoring;
	 - Concurrent conversion request management;
	 - Interrupt signal to Primary Interrupt Handler;
	 - Averaging feature;
	 - Selective enable/disable of the averaging feature.

	Say 'y' here to statically link this module into the kernel or 'm'
	to build it as a dinamically loadable module. The module will be
	called twl4030-madc.ko

config SENSORS_AKM8975
	tristate "AK8975"
	depends on I2C
	help
	  If you say yes here you get support for Asahi Kasei's
          orientation sensor AK8975.

config SENSORS_ADBS_A320
       tristate "ADBS A320 OFN mouse sensors"
       depends on I2C
       default y
       help
         If you say yes here you get support for the Taos ADBS A320
         ambient light sensor.

         This driver can also be built as a module.  If so, the module
         will be called ADBS A320.

config SENSORS_MMA7455
       tristate "Freescale MMA7455 Accelerometer sensor"
       depends on I2C && SYSFS
       default y
       help
         If you say yes here you get support for the Freescale
         MMA7455 Accelerometer sensor.

config SENSORS_TMD27713T
	bool "Taos asl tmd27713t"
	default y
	help
	  add asl-sensor tmd27713t

config SENSORS_MMC3280MS
	tristate "MEMSIC Magnetic Sensor Driver Support"
	depends on I2C
	help
	  If you say yes here you get support for the MEMSIC magnateic sensor

config ECOMPASS
	tristate "MEMSIC eCompass Driver Support"
	depends on I2C
	help
	  If you say yes here you get support for the MEMSIC eCompass
endmenu
```
